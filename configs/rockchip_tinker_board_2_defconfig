## configs/rockchip_tinker_board_2_defconfig
```kconfig
#include "rk3399_arm64.config"
#include "base.config"
#include "base_extra.config"
#include "gpu.config"
#include "video_mpp.config"
#include "powermanager.config"
#include "audio.config"
#include "wifi.config"
#include "network.config"
#include "bt.config"
BR2_TARGET_GENERIC_GETTY_PORT="ttyFIQ0"
BR2_TARGET_GENERIC_GETTY_BAUDRATE_1500000=y
BR2_ROOTFS_OVERLAY="board/rockchip/tinker_board_2/fs-overlay-64/"
BR2_TARGET_GENERIC_HOSTNAME="tinker_board_2"
BR2_TARGET_GENERIC_ISSUE="Welcome to Tinker Board 2/S Buildroot"
BR2_PACKAGE_ANDROID_TOOLS=n
BR2_PACKAGE_QLAUNCHER=n
BR2_PACKAGE_VIM=y
BR2_TARGET_GENERIC_ROOT_PASSWD="root"
```
